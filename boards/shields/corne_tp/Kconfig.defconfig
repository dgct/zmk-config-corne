## boards/shields/corne_tp/Kconfig.defconfig
```kconfig
# Central Side Configuration
#
# Left side is central so the nice!view display shows full status info
# (layers, battery, BT profile). The trackpoint on the right (peripheral)
# forwards input via zmk,input-split.

if SHIELD_CORNE_TP_LEFT

config ZMK_KEYBOARD_NAME
    default "Corne TP"

config ZMK_SPLIT_ROLE_CENTRAL
    default y

# Custom widget replaces the stock nice_view widget
config NICE_VIEW_WIDGET_STATUS
    default n

config CORNE_TP_CUSTOM_WIDGET
    bool "Corne TP custom nice!view widget with peripheral battery"
    default y if ZMK_DISPLAY
    select LV_FONT_MONTSERRAT_16
    select LV_FONT_MONTSERRAT_18
    select LV_FONT_MONTSERRAT_14
    select LV_FONT_UNSCII_8
    select LV_USE_IMAGE
    select LV_USE_CANVAS
    select ZMK_WPM

endif

# Options that should be enabled on both sides
if SHIELD_CORNE_TP_LEFT || SHIELD_CORNE_TP_RIGHT

config ZMK_SPLIT
    default y

config ZMK_POINTING
    default y

if ZMK_DISPLAY

config I2C
    default y

config SSD1306
    default y

endif # ZMK_DISPLAY

if LVGL

config LV_Z_VDB_SIZE
    default 64

config LV_DPI_DEF
    default 148

config LV_Z_BITS_PER_PIXEL
    default 1

choice LV_COLOR_DEPTH
    default LV_COLOR_DEPTH_1
endchoice

endif # LVGL

endif
```

## config/west.yml
```yaml
manifest:
  remotes:
    - name: zmkfirmware
      url-base: https://github.com/zmkfirmware
    - name: dgct
      url-base: https://github.com/dgct
    - name: badjeff
      url-base: https://github.com/badjeff
    - name: zettaface
      url-base: https://github.com/zettaface
  projects:
    - name: zmk
      remote: dgct
      import: app/west.yml
      revision: 2c908b25
    - name: kb_zmk_ps2_mouse_trackpoint_driver
      remote: dgct
      revision: diversity-receiver
    - name: zmk-softdevice-controller
      remote: dgct
      revision: audit-fixes
      import: config/west.yml
    - name: zmk-input-processor-keybind
      remote: zettaface
      revision: main
  self:
    path: config
```
